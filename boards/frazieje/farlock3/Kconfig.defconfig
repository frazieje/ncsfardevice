## drivers/far_nfc/Kconfig
```kconfig
menuconfig FAR_NFC
	bool "FAR NFC device drivers"
    depends on DT_HAS_FAR_NFC_ENABLED
	help
	  This option enables the FAR NFC custom driver class.

if FAR_NFC

config FAR_NFC_INIT_PRIORITY
	int "FAR NFC device drivers init priority"
	default KERNEL_INIT_PRIORITY_DEVICE
	help
	  FAR NFC device drivers init priority.

module = FAR_NFC
module-str = far_nfc
source "subsys/logging/Kconfig.template.log_config"

rsource "Kconfig.far_nfc_t4t"

endif # FAR_NFC
```

## drivers/far_nfc/Kconfig.far_nfc_t4t
```kconfig
config FAR_NFC_T4T
	bool "T4T FAR NFC driver"
	default y
	depends on DT_HAS_FAR_NFC_T4T
	select CONFIG_NFC_NDEF && \
           CONFIG_NFC_NDEF_MSG && \
           CONFIG_NFC_NDEF_RECORD && \
           CONFIG_NFC_NDEF_URI_REC && \
           CONFIG_NFC_NDEF_URI_MSG
	help
	  Enable this option to use T4T FAR NFC driver.
```
